macro_vs_format: macro_vs_format{
compatible = "zmk,behavior-macro";
label = "macro_vs_format";
#binding-cells = <0>;
bindings = <&kp LC(K)(>, <&kp LC(E)>;
};
macro_vs_uncomment: macro_vs_uncomment{
compatible = "zmk,behavior-macro";
label = "macro_vs_uncomment";
#binding-cells = <0>;
bindings = <&kp LC(E)>, <&kp LC(U)>;
};
macro_vs_comment: macro_vs_comment{
compatible = "zmk,behavior-macro";
label = "macro_vs_comment";
#binding-cells = <0>;
bindings = <&kp LC(E)>, <&kp LC(C)>;
};
macro_quotes: macro_quotes{
compatible = "zmk,behavior-macro";
label = "macro_quotes";
#binding-cells = <0>;
bindings = <&kp SQT>, <&kp SQT>, <&kp LEFT>;
};
macro_dquotes: macro_dquotes{
compatible = "zmk,behavior-macro";
label = "macro_dquotes";
#binding-cells = <0>;
bindings = <&kp DQT>, <&kp DQT>, <&kp LEFT>;
};
macro_braces: macro_braces{
compatible = "zmk,behavior-macro";
label = "macro_braces";
#binding-cells = <0>;
bindings = <&kp LBRC>, <&kp RBRC>, <&kp LEFT>;
};
macro_parens: macro_parens{
compatible = "zmk,behavior-macro";
label = "macro_parens";
#binding-cells = <0>;
bindings = <&kp LPAR>, <&kp RPAR>, <&kp LEFT>;
};
macro_brackets: macro_brackets{
compatible = "zmk,behavior-macro";
label = "macro_brackets";
#binding-cells = <0>;
bindings = <&kp LBKT>, <&kp RBKT>, <&kp LEFT>;
};
macro_kinesis: macro_kinesis{
compatible = "zmk,behavior-macro";
label = "macro_kinesis";
#binding-cells = <0>;
bindings = <&kp LS(K)>, <&kp I>, <&kp N>, <&kp E>, <&kp S>, <&kp I>, <&kp S>;
};